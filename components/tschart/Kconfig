## components/tschart/Kconfig
```kconfig
menu "tschart"

config TSCHART_MAX_SOURCES
    int "Maximum data sources per dataset"
    range 1 8
    default 4
    help
        Sources (sample arrays) one dataset can carry. Each costs a few
        bytes in every dataset struct.

endmenu
```

## main/Kconfig.projbuild
```kconfig
menu "Arctic Controller"

    config DEMO_MODE
        bool "Include demo mode (simulated heat pump, no bus)"
        default y
        help
            Compiles in demo mode: a fully simulated heat pump that runs with
            no RS485 bus attached, driven by seeded register values and the
            /api/heatpump/demo injection endpoint. Used for UI demos, kiosk
            units, and the automated API/device test suites.

            When disabled, all demo scaffolding (the seeded state, the demo
            sync task, the /api/heatpump/demo endpoint, and the Settings demo
            toggle) is excluded from the image and app_prefs_is_demo_mode()
            is always false. Leave enabled for production images for now;
            disable to ship a build that can only talk to a real bus.

    config TEST_ENDPOINTS
        bool "Enable test instrumentation endpoints (/api/test/*)"
        default n
        help
            Enables REST API endpoints for UI testing:
            - GET /api/test/ui-state  (read LVGL widget tree)
            - POST /api/test/click    (click widget by label text)
            These endpoints are intended for automated testing only
            and should be disabled in production builds.

    config ARCTIC_POISON_FIRMWARE
        bool "Build a deliberately-crashing image for OTA rollback validation"
        default n
        help
            Fault injection for the OTA rollback test (#252 T-02). When set,
            app_main() aborts deliberately, before the firmware is committed,
            to prove that an image which boots but dies before commit is rolled
            back by the bootloader rather than stranding the device. That is the
            failure a field device cannot recover from, having no serial console.

            The crash is gated on the running image actually being the
            unverified OTA copy (ESP_OTA_IMG_PENDING_VERIFY). This device has no
            factory partition, so USB recovery writes the app plus a fresh
            ota_data_initial and boots the slot as already-valid; a poison image
            recovered that way reports non-pending, suppresses the abort and
            comes up normally rather than crash-looping with no rollback target.

            NEVER enable this for a release. It is built by a dedicated CI job
            into a separate artifact, and create-release.yml refuses to publish
            an image with it set.

    choice ARCTIC_BUS_MODE
        prompt "Arctic RS485 bus mode"
        default ARCTIC_TUYA_LISTEN
        help
            Selects how the controller talks to the heat pump over RS485.

        config ARCTIC_TUYA_LISTEN
            bool "Passive Tuya listen (RX-only, no bus TX)"
            help
                Bench/validation mode. Instead of starting a bus master, the
                controller splices onto the existing controller<->heat pump
                RS485 bus in RECEIVE-ONLY mode and decodes the Tuya MCU framing
                (55 AA ...) using tuya_codec. The RS485 direction pin is held
                low and the UART TX line is left unrouted, so the Tab5 never
                transmits and is electrically invisible on the bus. Safe to run
                alongside the real controller. Wire settings: 4800 baud 8-E-1.

        config ARCTIC_TUYA_MASTER
            bool "Active Tuya master (drives the bus)"
            help
                Production control mode. The Tab5 becomes the SOLE bus master:
                it polls the telemetry register windows over fc=0x03 reads and
                issues fc=0x06 setpoint writes via the shared-library MaconLink
                layer. Wire settings: 4800 baud 8-E-1, RS485 half-duplex.

                SAFETY: two masters on one RS485 bus collide, so the OEM
                controller MUST be physically disconnected before enabling this
                mode. On boot the firmware listens for existing bus traffic and
                refuses to transmit if another master is detected.

    endchoice

endmenu
```
